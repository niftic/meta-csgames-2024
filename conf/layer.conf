## conf/layer.conf
```bitbake
# We have a conf and classes directory, add to BBPATH
BBPATH .= ":${LAYERDIR}"

# We have recipes-* directories, add to BBFILES
BBFILES += "${LAYERDIR}/recipes-*/*/*.bb \
            ${LAYERDIR}/recipes-*/*/*.bbappend"

BBFILE_COLLECTIONS += "meta-csgames"
BBFILE_PATTERN_meta-csgames = "^${LAYERDIR}/"
BBFILE_PRIORITY_meta-csgames = "6"

LAYERDEPENDS_meta-csgames = "core"
LAYERSERIES_COMPAT_meta-csgames = "kirkstone"
```
